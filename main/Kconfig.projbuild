## main/Kconfig.projbuild
```kconfig
menu "Irrifrance ESP32"

    config IRRI_ENABLE_TESTS
        bool "Activer les tests unitaires embarqués"
        default n
        help
            Active la compilation des fichiers test/test_*.c.
            Les tests s'exécutent au démarrage (app_main).
            À désactiver impérativement en production.

    config IRRI_TEST_MODE
        bool "Activer le simulateur web interactif"
        default n
        help
            Active main/simulator/* et les routes /test + /ws_test.
            Remplace gpio_get_level() par sim_gpio_get_level() via READ_GPIO.
            À désactiver impérativement en production.

    config IRRI_WOKWI_MODE
        bool "Mode Wokwi (tests e2e sans WiFi)"
        default n
        help
            Désactive webserver/OTA/telemetry et injecte une config programme
            de test dans NVS pour permettre à la machine d'états de démarrer.
            À utiliser uniquement avec les firmwares de test Wokwi.

    config IRRI_TPL5010
        bool "Activer le watchdog matériel TPL5010DDCR"
        default n
        help
            Active le watchdog hardware TPL5010DDCR sur GPIO13 (DONE).
            Câblage requis : TPL5010 RESET → ESP32 EN, Rext = 3,3 MΩ.
            Timeout ~5,3 s. Si state_machine_task() se bloque, l'ESP32
            est redémarré automatiquement par le hardware.
            Désactiver si le composant n'est pas câblé.

    config IRRI_PROD
        bool "Mode production (profil machine hard-codé)"
        default n
        help
            Profil machine et abaque compilés dans le firmware.
            NVS ignorée pour machine_active et abaque_idx (verrouillés).
            Les paramètres de calibration terrain restent modifiables en NVS.
            Firmware nommé irrifrance_{machine}_{canon}_v{version}.bin.
            Utiliser ce mode pour les firmwares de release.

    choice IRRI_MACHINE_SELECT
        prompt "Profil machine (mode PROD uniquement)"
        depends on IRRI_PROD
        default IRRI_MACHINE_ST1BIS_82_330

        config IRRI_MACHINE_ST1BIS_82_330
            bool "Structure 1 Bis — Ø82mm / 330m"

        # Ajouter ici les nouvelles machines contribuées

    endchoice

    choice IRRI_CANON_SELECT
        prompt "Abaque canon (mode PROD uniquement)"
        depends on IRRI_PROD
        default IRRI_CANON_SR100C

        config IRRI_CANON_SR100C
            bool "Irrifrance SR 100C"

        config IRRI_CANON_SR150C
            bool "Irrifrance SR 150C"

        # Ajouter ici les nouveaux canons contribués

    endchoice

endmenu
```

## sdkconfig.defaults
```kconfig
# sdkconfig.defaults — Irrifrance ESP32
# Valeurs par défaut compilées dans le firmware.
# Modifiables via "idf.py menuconfig" mais ces valeurs seront ré-appliquées
# à chaque "idf.py set-target" ou suppression du sdkconfig généré.

# --- FreeRTOS ---
# Tick à 1ms pour timing précis des cycles poumon et anti-rebond ISR
CONFIG_FREERTOS_HZ=1000
CONFIG_FREERTOS_TIMER_TASK_STACK_DEPTH=4096

# --- Tâche principale ---
CONFIG_ESP_MAIN_TASK_STACK_SIZE=8192

# --- Flash ---
CONFIG_ESPTOOLPY_FLASHSIZE_4MB=y
CONFIG_ESPTOOLPY_FLASHSIZE="4MB"

# --- Table de partition OTA ---
# Partition custom : 2 partitions app (OTA), NVS, SPIFFS (PR-08)
CONFIG_PARTITION_TABLE_CUSTOM=y
CONFIG_PARTITION_TABLE_CUSTOM_FILENAME="partitions.csv"

# --- WebSocket ---
CONFIG_HTTPD_WS_SUPPORT=y

# --- WiFi ---
# Mode Access Point uniquement — pas de réseau externe sur le terrain
CONFIG_ESP_WIFI_SOFTAP_SUPPORT=y
CONFIG_ESP32_WIFI_STATIC_RX_BUFFER_NUM=4
CONFIG_ESP32_WIFI_DYNAMIC_RX_BUFFER_NUM=8
# SSID et mot de passe configurés dans wifi_ap_init() (config_nvs ou hardcodé PR-07)
# SSID    : Irrifrance-ESP32
# Mot de passe : irrigation
# Canal   : 6
# IP fixe : 192.168.4.1

# --- mDNS ---
# Accessible via http://irrifrance.local depuis le navigateur mobile
CONFIG_MDNS_ENABLED=y
CONFIG_LWIP_LOCAL_HOSTNAME="irrifrance"

# --- Logs ---
# Niveau INFO par défaut — réduire à WARNING pour la prod terrain
CONFIG_LOG_DEFAULT_LEVEL=3

# --- NVS ---
# Pas de chiffrement NVS (pas de secure boot sur cette cible)
# CONFIG_NVS_ENCRYPTION is not set

# --- Tests unitaires ---
# Désactivé par défaut — activer avec "idf.py menuconfig" pour le dev
# CONFIG_IRRI_ENABLE_TESTS is not set
```

## sdkconfig.defaults.wokwi
```kconfig
# sdkconfig.defaults.wokwi — build dédié aux tests e2e Wokwi
# Usage : idf.py -DSDKCONFIG_DEFAULTS="sdkconfig.defaults;sdkconfig.defaults.wokwi" build

# Mode Wokwi : pas de WiFi, config programme injectée automatiquement
CONFIG_IRRI_WOKWI_MODE=y

# Désactiver le TWDT pour la simulation (la tâche WiFi n'existe pas, mais
# d'autres tâches système pourraient manquer leur reset en simulation lente)
CONFIG_ESP_TASK_WDT_EN=n
```
